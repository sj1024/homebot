/*
  IRsendRaw_ESP8266
*/
#define IRSEND 5

int testSignal[] = {9000,-4500,500,-500,500,-500,500,-1500,500,-500,500,-500,500,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500,0};
int onSignal[]  = {3100,-9800,470,-1550,470,-550,470,-550,470,-550,470,-1550,470,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470,0};
int offSignal[] = {3100,-9800,470,-1550,470,-550,470,-550,470,-550,470,-1550,470,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470,0};
int officeAircon_off[] = {17,-5393,15,-2,15,-2,14,-3,14,-3,14,-1564,17,-7,15,-1,17,-0,16,-2,0};

void setup() {
  wdt_disable();
  Serial.begin(9600);
  Serial.println("Ready to encode IR!");
}
 
void loop() {
  IRsend(IRSEND, officeAircon_off);      // GPIO pin 5 (D1 of NodeMCU, WeMos D1 Mini)
  delay(5000);
}
 
void IRsend(int IRpin, int IRsignal[]) {
  int i=0;
  pinMode(IRpin, OUTPUT);
  do {
    if (IRsignal[i]>0) {
      int duration = IRsignal[i];
      while (duration > 0) {
        digitalWrite(IRpin, HIGH);
        delayMicroseconds(10);
        digitalWrite(IRpin, LOW);
        delayMicroseconds(10);
        duration -= 26;         // 38 kHz = 26.3 uSec
      }
    }
    else {
      delayMicroseconds(abs(IRsignal[i]));
    }
    i+=1;
  }
  while (IRsignal[i] != 0);
}

